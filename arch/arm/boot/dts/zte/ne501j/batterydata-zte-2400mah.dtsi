/* Copyright (c) 2013, The Linux Foundation. All rights reserved.
 *
 * This program is free software; you can redistribute it and/or modify
 * it under the terms of the GNU General Public License version 2 and
 * only version 2 as published by the Free Software Foundation.
 *
 * This program is distributed in the hope that it will be useful,
 * but WITHOUT ANY WARRANTY; without even the implied warranty of
 * MERCHANTABILITY or FITNESS FOR A PARTICULAR PURPOSE.  See the
 * GNU General Public License for more details.
 */
/*
* CONFIG_ZTEMT_CHARGE
*/
qcom,zte-2400mah {
	qcom,fcc-mah = <2400>;
	qcom,default-rbatt-mohm = <129>;
	qcom,max-voltage-uv = <4350000>;
	qcom,rbatt-capacitive-mohm = <50>;
	qcom,v-cutoff-uv = <3400000>;
	qcom,chg-term-ua = <100000>;
	qcom,batt-id-kohm = <300>;

	qcom,fcc-temp-lut {
		qcom,lut-col-legend = <(-20)  0 25 40 60>;
		qcom,lut-data = <2469  2472  2469  2456  2450>;
	};

	qcom,pc-temp-ocv-lut {
		qcom,lut-col-legend = <(-20)  0 25 40 60>;
		qcom,lut-row-legend = <100 95 90 85 80>,
				<75 70 65 60 55>,
				<50 45 40 35 30>,
				<25 20 16 13 11>,
				<10 9 8 7 6>,
				<5 4 3 2 1>,
				<0>;
		qcom,lut-data = <4333 4332 4327 4323 4315>,
							<4247 4259 4261 4260 4255>,
							<4177 4200 4206 4205 4200>,
							<4114 4144 4152 4151 4147>,
							<4056 4091 4100 4100 4096>,
							<3989 4039 4053 4053 4048>,
							<3942 3980 4005 4006 4003>,
							<3902 3934 3963 3966 3963>,
							<3865 3895 3920 3924 3922>,
							<3835 3860 3869 3873 3871>,
							<3810 3830 3840 3842 3841>,
							<3789 3806 3817 3819 3818>,
							<3770 3788 3797 3799 3798>,
							<3753 3773 3782 3781 3780>,
							<3737 3759 3769 3765 3759>,
							<3720 3742 3753 3746 3733>,
							<3702 3723 3729 3722 3707>,
							<3683 3707 3697 3691 3677>,
							<3665 3695 3683 3677 3665>,
							<3650 3686 3681 3674 3663>,
							<3641 3681 3679 3673 3661>,
							<3629 3676 3677 3671 3659>,
							<3615 3669 3673 3668 3655>,
							<3598 3658 3666 3661 3644>,
							<3577 3639 3643 3642 3614>,
							<3548 3606 3603 3604 3573>,
							<3507 3556 3549 3555 3523>,
							<3449 3488 3483 3497 3463>,
							<3363 3392 3403 3425 3382>,
							<3233 3263 3284 3316 3256>,
							<3000 3000 3000 3000 3000>;
			};

	qcom,rbatt-sf-lut {
		qcom,lut-col-legend = <(-20) 0 25 40 60>;
		qcom,lut-row-legend = <100 95 90 85 80>,
				<75 70 65 60 55>,
				<50 45 40 35 30>,
				<25 20 16 13 11>,
				<10 9 8 7 6>,
				<5 4 3 2 1>,
				<0>;
		qcom,lut-data = <1438 321 100 77 69>,
												<1437 321 100 78 69>,
												<1407 332 106 82 72>,
												<1380 343 111 86 74>,
												<1373 351 117 89 77>,
												<1363 365 125 95 81>,
												<1389 355 133 99 84>,
												<1417 353 141 105 87>,
												<1445 359 136 107 89>,
												<1482 368 108 86 74>,
												<1535 382 109 82 74>,
												<1600 406 114 87 78>,
												<1675 437 122 93 82>,
												<1762 475 130 96 85>,
												<1926 518 137 96 82>,
												<2218 559 140 93 78>,
												<2544 603 140 93 76>,
												<2794 648 137 91 74>,
												<2714 664 138 91 75>,
												<2811 684 149 97 79>,
												<2997 705 155 100 80>,
												<3219 725 162 103 81>,
												<3494 753 168 105 82>,
												<3824 775 173 106 79>,
												<4250 796 169 103 79>,
												<4806 821 169 102 82>,
												<5523 853 177 106 89>,
												<6575 903 193 120 103>,
												<8443 981 233 142 111>,
												<14044 1566 277 162 137>,
												<39526 12585 2471 2394 668>;
	};
};
