/* Copyright (c) 2013, The Linux Foundation. All rights reserved.
 *
 * This program is free software; you can redistribute it and/or modify
 * it under the terms of the GNU General Public License version 2 and
 * only version 2 as published by the Free Software Foundation.
 *
 * This program is distributed in the hope that it will be useful,
 * but WITHOUT ANY WARRANTY; without even the implied warranty of
 * MERCHANTABILITY or FITNESS FOR A PARTICULAR PURPOSE.  See the
 * GNU General Public License for more details.
 */

/*---------------------------------------------------------------------------
 * This file is autogenerated file using gcdb parser. Please do not edit it.
 * Update input XML file to add a new entry or update variable in this file
 * VERSION = "1.0"
 *---------------------------------------------------------------------------*/
&mdss_mdp {
	dsi_lianchuang_nt35592_720_vid: qcom,mdss_dsi_lianchuang_nt35592_720p_video {
		qcom,mdss-dsi-panel-name = "lianchuang nt35592 720p video mode dsi panel";
		qcom,mdss-dsi-panel-controller = <&mdss_dsi0>;
		qcom,mdss-dsi-panel-type = "dsi_video_mode";
		qcom,mdss-dsi-panel-destination = "display_1";
		qcom,mdss-dsi-panel-framerate = <60>;
		qcom,mdss-dsi-virtual-channel-id = <0>;
		qcom,mdss-dsi-stream = <0>;
		qcom,mdss-dsi-panel-width = <720>;
		qcom,mdss-dsi-panel-height = <1280>;
		qcom,mdss-dsi-h-front-porch = <12>;
		qcom,mdss-dsi-h-back-porch = <12>;
		qcom,mdss-dsi-h-pulse-width = <4>;
		qcom,mdss-dsi-h-sync-skew = <0>;
		qcom,mdss-dsi-v-back-porch = <2>;
		qcom,mdss-dsi-v-front-porch = <6>;
		qcom,mdss-dsi-v-pulse-width = <2>;
		qcom,mdss-dsi-h-left-border = <0>;
		qcom,mdss-dsi-h-right-border = <0>;
		qcom,mdss-dsi-v-top-border = <0>;
		qcom,mdss-dsi-v-bottom-border = <0>;
		qcom,mdss-dsi-bpp = <24>;
		qcom,mdss-dsi-color-order = <0>;
		qcom,mdss-dsi-underflow-color = <0xff>;
		qcom,mdss-dsi-border-color = <0>;
		qcom,mdss-dsi-on-command = [
            //CMD2 Page0 -Power 
            29 01 00 00 00 00 02 FF 01
            29 01 00 00 00 00 02 FB 01
            29 01 00 00 00 00 02 00 4A
            29 01 00 00 00 00 02 01 33
            29 01 00 00 00 00 02 02 53
            29 01 00 00 00 00 02 03 55
            29 01 00 00 00 00 02 04 55
            29 01 00 00 00 00 02 05 33
            29 01 00 00 00 00 02 06 22
            29 01 00 00 00 00 02 08 56
            29 01 00 00 00 00 02 09 8f
            29 01 00 00 00 00 02 0B CF
            29 01 00 00 00 00 02 0C CF
            29 01 00 00 00 00 02 0D 2F
            29 01 00 00 00 00 02 0E 29
            29 01 00 00 00 00 02 36 73
            29 01 00 00 00 00 02 0f 0a
            //power mode 
            29 01 00 00 00 00 02 ff ee
            29 01 00 00 00 00 02 fb 01
            29 01 00 00 00 00 02 2b 10
            //CMD2 Page 4 -Display Register
            29 01 00 00 00 00 02 FF 05
            29 01 00 00 00 00 02 FB 01
            29 01 00 00 00 00 02 01 00
            29 01 00 00 00 00 02 02 82
            29 01 00 00 00 00 02 03 82
            29 01 00 00 00 00 02 04 82
            29 01 00 00 00 00 02 06 33
            29 01 00 00 00 00 02 07 01
            29 01 00 00 00 00 02 08 00
            29 01 00 00 00 00 02 09 46
            29 01 00 00 00 00 02 0A 46
            29 01 00 00 00 00 02 0D 0B
            29 01 00 00 00 00 02 0E 1D
            29 01 00 00 00 00 02 0F 08
            29 01 00 00 00 00 02 10 53
            29 01 00 00 00 00 02 11 00
            29 01 00 00 00 00 02 12 00
            29 01 00 00 00 00 02 14 01
            29 01 00 00 00 00 02 15 00
            29 01 00 00 00 00 02 16 05
            29 01 00 00 00 00 02 17 00
            29 01 00 00 00 00 02 19 7F
            29 01 00 00 00 00 02 1A FF
            29 01 00 00 00 00 02 1B 0F
            29 01 00 00 00 00 02 1C 00
            29 01 00 00 00 00 02 1D 00
            29 01 00 00 00 00 02 1E 00
            29 01 00 00 00 00 02 1F 07
            29 01 00 00 00 00 02 20 00
            29 01 00 00 00 00 02 21 00
            29 01 00 00 00 00 02 22 55
            29 01 00 00 00 00 02 23 4d
            29 01 00 00 00 00 02 2D 02
            29 01 00 00 00 00 02 83 01
            29 01 00 00 00 00 02 9e 58
            29 01 00 00 00 00 02 9f 68
            29 01 00 00 00 00 02 a0 01
            29 01 00 00 00 00 02 a2 10
            29 01 00 00 00 00 02 bb 0a
            29 01 00 00 00 00 02 bc 0a
            29 01 00 00 00 00 02 28 01
            29 01 00 00 00 00 02 2f 02
            29 01 00 00 00 00 02 32 08
            29 01 00 00 00 00 02 33 b8
            29 01 00 00 00 00 02 36 01
            29 01 00 00 00 00 02 37 00
            29 01 00 00 00 00 02 43 00
            29 01 00 00 00 00 02 4b 21
            29 01 00 00 00 00 02 4c 03
            29 01 00 00 00 00 02 50 21
            29 01 00 00 00 00 02 51 03
            29 01 00 00 00 00 02 58 21
            29 01 00 00 00 00 02 59 03
            29 01 00 00 00 00 02 5d 21
            29 01 00 00 00 00 02 5e 03
            29 01 00 00 00 00 02 6c 00
            29 01 00 00 00 00 02 6d 00
            //non-reload MTP
            //CMD1
            29 01 00 00 00 00 02 FF 00 
            29 01 00 00 00 00 02 fb 01
            //CMD2, Page0
            29 01 00 00 00 00 02 FF 01 
            29 01 00 00 00 00 02 fb 01
            //CMD2, Page1
            29 01 00 00 00 00 02 FF 02 
            29 01 00 00 00 00 02 fb 01
            //CMD2, Page2
            29 01 00 00 00 00 02 FF 03
            29 01 00 00 00 00 02 fb 01
            //CMD2, Page3
            29 01 00 00 00 00 02 FF 04
            29 01 00 00 00 00 02 fb 01
            //CMD2, Page4
            29 01 00 00 00 00 02 FF 05
            29 01 00 00 00 00 02 fb 01
            //CMD1
            29 01 00 00 00 00 02 FF 00 
            29 01 00 00 00 00 02 fb 01			
            29 01 00 00 00 00 02 BA 03
            39 01 00 00 00 00 02 35 00
            39 01 00 00 78 00 02 11 00
            39 01 00 00 00 00 02 53 2c
            39 01 00 00 00 00 02 55 00            
            39 01 00 00 00 00 02 29 00      
		];
		qcom,mdss-dsi-off-command = [39 01 00 00 32 00 02 28 00
					39 01 00 00 78 00 02 10 00];
		qcom,mdss-dsi-on-command-state = "dsi_lp_mode";
		qcom,mdss-dsi-off-command-state = "dsi_hs_mode";
		qcom,mdss-dsi-h-sync-pulse = <1>;
		qcom,mdss-dsi-traffic-mode = "burst_mode";
		qcom,mdss-dsi-lane-map = <0>;
		qcom,mdss-dsi-bllp-eof-power-mode;
		qcom,mdss-dsi-bllp-power-mode;
		qcom,mdss-dsi-lane-0-state;
		qcom,mdss-dsi-lane-1-state;
		qcom,mdss-dsi-lane-2-state;
		qcom,mdss-dsi-lane-3-state;
		// dsi panel timings from lianchuang(mass production)
        qcom,mdss-dsi-panel-timings = [93 1F 17 00 2f 50 1c 21 26 03 04 00];
		qcom,mdss-dsi-t-clk-post = <0x4>;
		qcom,mdss-dsi-t-clk-pre = <0x12>;
		qcom,mdss-dsi-bl-min-level = <1>;
		qcom,mdss-dsi-bl-max-level = <255>;
		qcom,mdss-dsi-dma-trigger = <4>;
		qcom,mdss-dsi-mdp-trigger = <0>;
		qcom,mdss-dsi-bl-pmic-control-type = "bl_ctrl_dcs";
		qcom,mdss-dsi-reset-sequence = <1 1500>, <0 1000>, <1 50000>;
		qcom,mdss-pan-physical-width-dimension = <59>;
		qcom,mdss-pan-physical-height-dimension = <104>;
	};
};
