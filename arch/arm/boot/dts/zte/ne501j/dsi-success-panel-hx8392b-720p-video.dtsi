/* Copyright (c) 2013, The Linux Foundation. All rights reserved.
 *
 * This program is free software; you can redistribute it and/or modify
 * it under the terms of the GNU General Public License version 2 and
 * only version 2 as published by the Free Software Foundation.
 *
 * This program is distributed in the hope that it will be useful,
 * but WITHOUT ANY WARRANTY; without even the implied warranty of
 * MERCHANTABILITY or FITNESS FOR A PARTICULAR PURPOSE.  See the
 * GNU General Public License for more details.
 */

/*---------------------------------------------------------------------------
 * This file is autogenerated file using gcdb parser. Please do not edit it.
 * Update input XML file to add a new entry or update variable in this file
 * VERSION = "1.0"
 *---------------------------------------------------------------------------*/
&mdss_mdp {
	dsi_success_hx8392b_720_vid: qcom,mdss_dsi_success_hx8392b_720p_video {
		qcom,mdss-dsi-panel-name = "success hx8392b 720p video mode dsi panel";
		qcom,mdss-dsi-panel-controller = <&mdss_dsi0>;
		qcom,mdss-dsi-panel-type = "dsi_video_mode";
		qcom,mdss-dsi-panel-destination = "display_1";
		qcom,mdss-dsi-panel-framerate = <60>;
		qcom,mdss-dsi-virtual-channel-id = <0>;
		qcom,mdss-dsi-stream = <0>;
		qcom,mdss-dsi-panel-width = <720>;
		qcom,mdss-dsi-panel-height = <1280>;
		qcom,mdss-dsi-h-front-porch = <76>;
		qcom,mdss-dsi-h-back-porch = <80>;
		qcom,mdss-dsi-h-pulse-width = <76>;
		qcom,mdss-dsi-h-sync-skew = <0>;
		qcom,mdss-dsi-v-back-porch = <8>;
		qcom,mdss-dsi-v-front-porch = <17>;
		qcom,mdss-dsi-v-pulse-width = <2>;
		qcom,mdss-dsi-h-left-border = <0>;
		qcom,mdss-dsi-h-right-border = <0>;
		qcom,mdss-dsi-v-top-border = <0>;
		qcom,mdss-dsi-v-bottom-border = <0>;
		qcom,mdss-dsi-bpp = <24>;
		qcom,mdss-dsi-color-order = <0>;
		qcom,mdss-dsi-underflow-color = <0xff>;
		qcom,mdss-dsi-border-color = <0>;
		qcom,mdss-dsi-on-command = [
            39 01 00 00 00 00 04 B9 FF 83 92
            39 01 00 00 00 00 02 35 00
            39 01 00 00 00 00 18 B1 4D 45 45 14 3B 31 55 12 ED B3 B1 50 0F 43 F0 C0 C0 C0 C0 00 02 16 19
            39 01 00 00 00 00 13 B2 00 00 C8 08 0F 72 1B 08 0F 1B 1B 02 02 30 04 00 00 48
            39 01 00 00 00 00 29 B4 00 FF 20 24 00 3F 00 3F 05 00 02 03 03 0C 02 03 04 01 00 07 36 20 24 00 3F 00 3F 05 00 02 03 00 0C 02 03 04 01 00 07 36
            39 01 00 00 00 00 03 B6 74 74
            39 01 00 00 00 00 2b E0 00 16 1A 2B 2F 3F 26 3B 08 0D 0E 12 15 13 13 12 13 00 15 1A 2A 2F 3F 25 3C 08 0D 0F 12 15 13 14 10 14 0B 17 09 12 0C 18 08 11
            39 01 00 00 00 00 02 BA 03
            39 01 00 00 00 00 02 CC 08
            39 01 00 00 00 00 29 D3 00 00 01 00 01 10 28 08 32 30 05 00 05 32 13 C0 00 00 32 10 08 00 00 11 05 05 01 04 00 27 00 00 00 0A 00 11 00 00 00 00
            39 01 00 00 00 00 37 D5 21 21 1F 1F 1E 1E 1C 1C 1D 1D 19 19 18 18 18 18 18 18 18 18 18 18 18 18 18 18 18 18 18 18 18 18 18 18 18 18 18 18 18 18 18 18 18 18 18 18 18 18 2F 2F 30 30 31 31
            39 01 00 00 00 00 37 D6 21 21 1F 1F 1E 1E 1D 1D 1C 1C 19 19 18 18 18 18 18 18 18 18 18 18 18 18 18 18 18 18 18 18 18 18 18 18 18 18 18 18 18 18 18 18 18 18 18 18 18 18 2F 2F 30 30 31 31
            39 01 00 00 00 00 02 BD 00
            39 01 00 00 00 00 1d D8 82 C0 00 00 00 00 A8 82 C0 00 00 00 00 A8 82 C0 00 00 00 00 A8 82 C0 00 00 00 00 A8
            39 01 00 00 00 00 02 BD 01
            39 01 00 00 00 00 2b D8 00 00 00 00 00 00 00 00 00 00 00 00 00 00 82 C0 00 00 00 00 A8 82 C0 00 00 00 00 A8 00 00 00 00 00 00 00 00 00 00 00 00 00 00
            39 01 00 00 00 00 02 BD 02
            39 01 00 00 00 00 0f D8 82 E0 00 00 00 00 FC 82 E0 00 00 00 00 FC
            39 01 00 00 00 00 02 BD 00
            39 01 00 00 00 00 04 D9 00 01 02
            39 01 00 00 96 00 02 11 00
            39 01 00 00 00 00 03 C9 1F 0A
            39 01 00 00 78 00 02 29 00
            39 01 00 00 00 00 02 55 01
            39 01 00 00 00 00 02 53 24
		];
		qcom,mdss-dsi-off-command = [39 01 00 00 32 00 02 28 00
					39 01 00 00 78 00 02 10 00];
		qcom,mdss-dsi-on-command-state = "dsi_lp_mode";
		qcom,mdss-dsi-off-command-state = "dsi_hs_mode";
		qcom,mdss-dsi-h-sync-pulse = <1>;
		qcom,mdss-dsi-traffic-mode = "burst_mode";
		qcom,mdss-dsi-lane-map = <0>;
		qcom,mdss-dsi-bllp-eof-power-mode;
		qcom,mdss-dsi-bllp-power-mode;
		qcom,mdss-dsi-lane-0-state;
		qcom,mdss-dsi-lane-1-state;
		qcom,mdss-dsi-lane-2-state;
		qcom,mdss-dsi-lane-3-state;
		qcom,mdss-dsi-panel-timings = [37 1c 12 00 40 44 16 1e 17 03 04 00];
		qcom,mdss-dsi-t-clk-post = <0x4>;
		qcom,mdss-dsi-t-clk-pre = <0x18>;
		qcom,mdss-dsi-bl-min-level = <1>;
		qcom,mdss-dsi-bl-max-level = <255>;
		qcom,mdss-dsi-dma-trigger = <4>;
		qcom,mdss-dsi-mdp-trigger = <0>;
		qcom,mdss-dsi-bl-pmic-control-type = "bl_ctrl_dcs";
		qcom,mdss-dsi-reset-sequence = <1 1500>, <0 30>, <1 23000>;
		qcom,mdss-pan-physical-width-dimension = <59>;
		qcom,mdss-pan-physical-height-dimension = <104>;

	};
};
