/* Copyright (c) 2013, The Linux Foundation. All rights reserved.
 *
 * This program is free software; you can redistribute it and/or modify
 * it under the terms of the GNU General Public License version 2 and
 * only version 2 as published by the Free Software Foundation.
 *
 * This program is distributed in the hope that it will be useful,
 * but WITHOUT ANY WARRANTY; without even the implied warranty of
 * MERCHANTABILITY or FITNESS FOR A PARTICULAR PURPOSE.  See the
 * GNU General Public License for more details.
 */

/*---------------------------------------------------------------------------
 * This file is autogenerated file using gcdb parser. Please do not edit it.
 * Update input XML file to add a new entry or update variable in this file
 * VERSION = "1.0"
 *---------------------------------------------------------------------------*/
&mdss_mdp {
	dsi_cs_nt35592_720_vid: qcom,mdss_dsi_cs_nt35592_720p_video {
		qcom,mdss-dsi-panel-name = "cs nt35592 720p video mode dsi panel";
		qcom,mdss-dsi-panel-controller = <&mdss_dsi0>;
		qcom,mdss-dsi-panel-type = "dsi_video_mode";
		qcom,mdss-dsi-panel-destination = "display_1";
		qcom,mdss-dsi-panel-framerate = <60>;
		qcom,mdss-dsi-virtual-channel-id = <0>;
		qcom,mdss-dsi-stream = <0>;
		qcom,mdss-dsi-panel-width = <720>;
		qcom,mdss-dsi-panel-height = <1280>;
		qcom,mdss-dsi-h-front-porch = <12>;
		qcom,mdss-dsi-h-back-porch = <12>;
		qcom,mdss-dsi-h-pulse-width = <4>;
		qcom,mdss-dsi-h-sync-skew = <0>;
		qcom,mdss-dsi-v-back-porch = <2>;
		qcom,mdss-dsi-v-front-porch = <6>;
		qcom,mdss-dsi-v-pulse-width = <2>;
		qcom,mdss-dsi-h-left-border = <0>;
		qcom,mdss-dsi-h-right-border = <0>;
		qcom,mdss-dsi-v-top-border = <0>;
		qcom,mdss-dsi-v-bottom-border = <0>;
		qcom,mdss-dsi-bpp = <24>;
		qcom,mdss-dsi-color-order = <0>;
		qcom,mdss-dsi-underflow-color = <0xff>;
		qcom,mdss-dsi-border-color = <0>;
		qcom,mdss-dsi-on-command = [
            //CMD2 Page0 -Power 
            29 01 00 00 00 00 02 FF 01
            29 01 00 00 00 00 02 FB 01
            29 01 00 00 00 00 02 00 2A
            29 01 00 00 00 00 02 01 33
            29 01 00 00 00 00 02 02 53
            29 01 00 00 00 00 02 03 55
            29 01 00 00 00 00 02 04 55
            29 01 00 00 00 00 02 05 00
            29 01 00 00 00 00 02 06 44
            29 01 00 00 00 00 02 08 26
            29 01 00 00 00 00 02 09 09
            //// GVDDP  GVDDN 
            29 01 00 00 00 00 02 0B CA
            29 01 00 00 00 00 02 0C CA
            29 01 00 00 00 00 02 0D 24
            29 01 00 00 00 00 02 0E 2B
            //VGLO = -6.2V  
            29 01 00 00 00 00 02 0F 96
            29 01 00 00 00 00 02 10 0F
            //VCOMDC 
            29 01 00 00 00 00 02 11 72
            29 01 00 00 00 00 02 12 03
            //power mode 
            29 01 00 00 00 00 02 14 01
            //Gate EQ 
            29 01 00 00 00 00 02 36 73
            //VGLO pull GND
            29 01 00 00 00 00 02 37 02
			29 01 00 00 00 00 02 4c 01
			29 01 00 00 00 00 02 6f 00
            29 01 00 00 00 00 02 71 2C
			29 01 00 00 00 00 02 ff 00
			29 01 00 00 00 00 02 fb 01
			//gamma begin
			//Page Select CMD2,Page0 
            29 01 00 00 00 00 02 FF 01
            //Don't reload MTP 
            29 01 00 00 00 00 02 FB 01
            //Gamma R+ 
            29 01 00 00 00 00 02 75 00
            29 01 00 00 00 00 02 76 5F
            29 01 00 00 00 00 02 77 00
            29 01 00 00 00 00 02 78 97
            29 01 00 00 00 00 02 79 00
            29 01 00 00 00 00 02 7A A1
            29 01 00 00 00 00 02 7B 00
            29 01 00 00 00 00 02 7C B8
            29 01 00 00 00 00 02 7D 00
            29 01 00 00 00 00 02 7E CC
            29 01 00 00 00 00 02 7F 00
            29 01 00 00 00 00 02 80 E2
            29 01 00 00 00 00 02 81 00
            29 01 00 00 00 00 02 82 EC
            29 01 00 00 00 00 02 83 00
            29 01 00 00 00 00 02 84 F9
            29 01 00 00 00 00 02 85 01
            29 01 00 00 00 00 02 86 08
            29 01 00 00 00 00 02 87 01
            29 01 00 00 00 00 02 88 2F
            29 01 00 00 00 00 02 89 01
            29 01 00 00 00 00 02 8A 50
            29 01 00 00 00 00 02 8B 01
            29 01 00 00 00 00 02 8C 8E
            29 01 00 00 00 00 02 8D 01
            29 01 00 00 00 00 02 8E B6
            29 01 00 00 00 00 02 8F 01
            29 01 00 00 00 00 02 90 FD
            29 01 00 00 00 00 02 91 02
            29 01 00 00 00 00 02 92 2E
            29 01 00 00 00 00 02 93 02
            29 01 00 00 00 00 02 94 2E
            29 01 00 00 00 00 02 95 02
            29 01 00 00 00 00 02 96 5E
            29 01 00 00 00 00 02 97 02
            29 01 00 00 00 00 02 98 94
            29 01 00 00 00 00 02 99 02
            29 01 00 00 00 00 02 9A B4
            29 01 00 00 00 00 02 9B 02
            29 01 00 00 00 00 02 9C DB
            29 01 00 00 00 00 02 9D 02
            29 01 00 00 00 00 02 9E FD
            29 01 00 00 00 00 02 9F 03
            29 01 00 00 00 00 02 A0 24
            29 01 00 00 00 00 01 A1
            29 01 00 00 00 00 02 A2 03
            29 01 00 00 00 00 02 A3 30
            29 01 00 00 00 00 02 A4 03
            29 01 00 00 00 00 02 A5 3C
            29 01 00 00 00 00 02 A6 03
            29 01 00 00 00 00 02 A7 5B
            29 01 00 00 00 00 01 A8
            29 01 00 00 00 00 02 A9 03
            29 01 00 00 00 00 02 AA 80
            29 01 00 00 00 00 02 AB 03
            29 01 00 00 00 00 02 AC A3
            29 01 00 00 00 00 02 AD 03
            29 01 00 00 00 00 02 AE B1
            29 01 00 00 00 00 02 AF 03
            29 01 00 00 00 00 02 B0 BE
            29 01 00 00 00 00 02 B1 03
            29 01 00 00 00 00 02 B2 BD
            //Gamma R- 
            29 01 00 00 00 00 02 B3 00
            29 01 00 00 00 00 02 B4 D9
            29 01 00 00 00 00 02 B5 01
            29 01 00 00 00 00 02 B6 0D
            29 01 00 00 00 00 02 B7 01
            29 01 00 00 00 00 02 B8 13
            29 01 00 00 00 00 02 B9 01
            29 01 00 00 00 00 02 BA 26
            29 01 00 00 00 00 02 BB 01
            29 01 00 00 00 00 02 BC 3A
            29 01 00 00 00 00 02 BD 01
            29 01 00 00 00 00 02 BE 4F
            29 01 00 00 00 00 02 BF 01
            29 01 00 00 00 00 02 C0 5A
            29 01 00 00 00 00 02 C1 01
            29 01 00 00 00 00 02 C2 66
            29 01 00 00 00 00 02 C3 01
            29 01 00 00 00 00 02 C4 6B
            29 01 00 00 00 00 02 C5 01
            29 01 00 00 00 00 02 C6 97
            29 01 00 00 00 00 02 C7 01
            29 01 00 00 00 00 02 C8 B1
            29 01 00 00 00 00 02 C9 01
            29 01 00 00 00 00 02 CA E8
            29 01 00 00 00 00 02 CB 02
            29 01 00 00 00 00 02 CC 0C
            29 01 00 00 00 00 02 CD 02
            29 01 00 00 00 00 02 CE 48
            29 01 00 00 00 00 02 CF 02
            29 01 00 00 00 00 02 D0 7E
            29 01 00 00 00 00 02 D1 02
            29 01 00 00 00 00 02 D2 7E
            29 01 00 00 00 00 02 D3 02
            29 01 00 00 00 00 02 D4 AE
            29 01 00 00 00 00 02 D5 02
            29 01 00 00 00 00 02 D6 E4
            29 01 00 00 00 00 02 D7 03
            29 01 00 00 00 00 02 D8 03
            29 01 00 00 00 00 02 D9 03
            29 01 00 00 00 00 02 DA 33
            29 01 00 00 00 00 02 DB 03
            29 01 00 00 00 00 02 DC 57
            29 01 00 00 00 00 02 DD 03
            29 01 00 00 00 00 02 DE 83
            29 01 00 00 00 00 02 DF 03
            29 01 00 00 00 00 02 E0 8D
            29 01 00 00 00 00 02 E1 03
            29 01 00 00 00 00 02 E2 99
            29 01 00 00 00 00 02 E3 03
            29 01 00 00 00 00 02 E4 B7
            29 01 00 00 00 00 02 E5 03
            29 01 00 00 00 00 02 E6 CF
            29 01 00 00 00 00 02 E7 03
            29 01 00 00 00 00 02 E8 D8
            29 01 00 00 00 00 02 E9 03
            29 01 00 00 00 00 02 EA E6
            29 01 00 00 00 00 02 EB 03
            29 01 00 00 00 00 02 EC E8
            29 01 00 00 00 00 02 ED 03
            29 01 00 00 00 00 02 EE EA
            //Gamma G+ 
            29 01 00 00 00 00 02 EF 00
            29 01 00 00 00 00 02 F0 2D
            29 01 00 00 00 00 02 F1 00
            29 01 00 00 00 00 02 F2 71
            29 01 00 00 00 00 02 F3 00
            29 01 00 00 00 00 02 F4 87
            29 01 00 00 00 00 02 F5 00
            29 01 00 00 00 00 02 F6 A1
            29 01 00 00 00 00 02 F7 00
            29 01 00 00 00 00 02 F8 B2
            29 01 00 00 00 00 02 F9 00
            29 01 00 00 00 00 02 FA CB
            29 01 00 00 00 00 02 FB 01
            //Page Select CMD1 
            29 01 00 00 00 00 02 FF 00
            //Don't reload MTP 
            29 01 00 00 00 00 02 FB 01
            //Page Select CMD2,Page1 
            29 01 00 00 00 00 02 FF 02
            //Don't reload MTP 
            29 01 00 00 00 00 02 FB 01
            29 01 00 00 00 00 02 00 00
            29 01 00 00 00 00 02 01 D7
            29 01 00 00 00 00 02 02 00
            29 01 00 00 00 00 02 03 E6
            29 01 00 00 00 00 02 04 00
            29 01 00 00 00 00 02 05 F9
            29 01 00 00 00 00 02 06 01
            29 01 00 00 00 00 02 07 2C
            29 01 00 00 00 00 02 08 01
            29 01 00 00 00 00 02 09 4F
            29 01 00 00 00 00 02 0A 01
            29 01 00 00 00 00 02 0B 86
            29 01 00 00 00 00 02 0C 01
            29 01 00 00 00 00 02 0D B3
            29 01 00 00 00 00 02 0E 01
            29 01 00 00 00 00 02 0F FC
            29 01 00 00 00 00 02 10 02
            29 01 00 00 00 00 02 11 2E
            29 01 00 00 00 00 02 12 02
            29 01 00 00 00 00 02 13 2E
            29 01 00 00 00 00 02 14 02
            29 01 00 00 00 00 02 15 5D
            29 01 00 00 00 00 02 16 02
            29 01 00 00 00 00 02 17 92
            29 01 00 00 00 00 02 18 02
            29 01 00 00 00 00 02 19 B2
            29 01 00 00 00 00 02 1A 02
            29 01 00 00 00 00 02 1B DC
            29 01 00 00 00 00 02 1C 02
            29 01 00 00 00 00 02 1D FF
            29 01 00 00 00 00 02 1E 03
            29 01 00 00 00 00 02 1F 27
            29 01 00 00 00 00 02 20 03
            29 01 00 00 00 00 02 21 3B
            29 01 00 00 00 00 02 22 03
            29 01 00 00 00 00 02 23 45
            29 01 00 00 00 00 02 24 03
            29 01 00 00 00 00 02 25 63
            29 01 00 00 00 00 02 26 03
            29 01 00 00 00 00 02 27 77
            29 01 00 00 00 00 02 28 03
            29 01 00 00 00 00 02 29 95
            29 01 00 00 00 00 02 2A 03
            29 01 00 00 00 00 02 2B 9E
            29 01 00 00 00 00 01 2C
            29 01 00 00 00 00 02 2D 03
            29 01 00 00 00 00 01 2E
            29 01 00 00 00 00 02 2F A4
            29 01 00 00 00 00 02 30 03
            29 01 00 00 00 00 02 31 BC
            //Gamma G- 
            29 01 00 00 00 00 02 32 00
            29 01 00 00 00 00 02 33 B2
            29 01 00 00 00 00 02 34 00
            29 01 00 00 00 00 02 35 F1
            29 01 00 00 00 00 02 36 00
            29 01 00 00 00 00 02 37 FC
            29 01 00 00 00 00 02 38 01
            29 01 00 00 00 00 02 39 13
            29 01 00 00 00 00 02 3A 01
            29 01 00 00 00 00 02 3B 21
            29 01 00 00 00 00 01 3C
            29 01 00 00 00 00 02 3D 01
            29 01 00 00 00 00 01 3E
            29 01 00 00 00 00 02 3F 37
            29 01 00 00 00 00 02 40 01
            29 01 00 00 00 00 02 41 44
            29 01 00 00 00 00 02 42 01
            29 01 00 00 00 00 02 43 51
            29 01 00 00 00 00 02 44 01
            29 01 00 00 00 00 02 45 65
            29 01 00 00 00 00 02 46 01
            29 01 00 00 00 00 02 47 8A
            29 01 00 00 00 00 02 48 01
            29 01 00 00 00 00 02 49 A8
            29 01 00 00 00 00 02 4A 01
            29 01 00 00 00 00 02 4B E2
            29 01 00 00 00 00 02 4C 02
            29 01 00 00 00 00 02 4D 0B
            29 01 00 00 00 00 02 4E 02
            29 01 00 00 00 00 02 4F 48
            29 01 00 00 00 00 02 50 02
            29 01 00 00 00 00 02 51 7E
            29 01 00 00 00 00 02 52 02
            29 01 00 00 00 00 02 53 7E
            29 01 00 00 00 00 02 54 02
            29 01 00 00 00 00 02 55 AD
            29 01 00 00 00 00 02 56 02
            29 01 00 00 00 00 01 57
            29 01 00 00 00 00 02 58 E4
            29 01 00 00 00 00 02 59 03
            29 01 00 00 00 00 02 5A 06
            29 01 00 00 00 00 02 5B 03
            29 01 00 00 00 00 02 5C 35
            29 01 00 00 00 00 02 5D 03
            29 01 00 00 00 00 02 5E 59
            29 01 00 00 00 00 02 5F 03
            29 01 00 00 00 00 02 60 80
            29 01 00 00 00 00 02 61 03
            29 01 00 00 00 00 02 62 93
            29 01 00 00 00 00 02 63 03
            29 01 00 00 00 00 02 64 A1
            29 01 00 00 00 00 02 65 03
            29 01 00 00 00 00 02 66 C0
            29 01 00 00 00 00 02 67 03
            29 01 00 00 00 00 02 68 D4
            29 01 00 00 00 00 02 69 03
            29 01 00 00 00 00 02 6A DD
            29 01 00 00 00 00 02 6B 03
            29 01 00 00 00 00 02 6C E3
            29 01 00 00 00 00 02 6D 03
            29 01 00 00 00 00 02 6E E7
            29 01 00 00 00 00 02 6F 03
            29 01 00 00 00 00 02 70 EA
            //Gamma B+ 
            29 01 00 00 00 00 02 71 00
            29 01 00 00 00 00 02 72 5F
            29 01 00 00 00 00 02 73 00
            29 01 00 00 00 00 02 74 97
            29 01 00 00 00 00 02 75 00
            29 01 00 00 00 00 02 76 A1
            29 01 00 00 00 00 02 77 00
            29 01 00 00 00 00 02 78 B6
            29 01 00 00 00 00 02 79 00
            29 01 00 00 00 00 02 7A C6
            29 01 00 00 00 00 02 7B 00
            29 01 00 00 00 00 02 7C D9
            29 01 00 00 00 00 02 7D 00
            29 01 00 00 00 00 02 7E E2
            29 01 00 00 00 00 02 7F 00
            29 01 00 00 00 00 02 80 F1
            29 01 00 00 00 00 02 81 00
            29 01 00 00 00 00 02 82 FD
            29 01 00 00 00 00 02 83 01
            29 01 00 00 00 00 02 84 26
            29 01 00 00 00 00 02 85 01
            29 01 00 00 00 00 02 86 45
            29 01 00 00 00 00 02 87 01
            29 01 00 00 00 00 02 88 83
            29 01 00 00 00 00 02 89 01
            29 01 00 00 00 00 02 8A AF
            29 01 00 00 00 00 02 8B 01
            29 01 00 00 00 00 02 8C F7
            29 01 00 00 00 00 02 8D 02
            29 01 00 00 00 00 02 8E 21
            29 01 00 00 00 00 02 8F 02
            29 01 00 00 00 00 02 90 21
            29 01 00 00 00 00 02 91 02
            29 01 00 00 00 00 02 92 5A
            29 01 00 00 00 00 02 93 02
            29 01 00 00 00 00 02 94 90
            29 01 00 00 00 00 02 95 02
            29 01 00 00 00 00 02 96 B1
            29 01 00 00 00 00 02 97 02
            29 01 00 00 00 00 02 98 DB
            29 01 00 00 00 00 02 99 02
            29 01 00 00 00 00 02 9A F7
            29 01 00 00 00 00 02 9B 03
            29 01 00 00 00 00 02 9C 1E
            29 01 00 00 00 00 02 9D 03
            29 01 00 00 00 00 02 9E 29
            29 01 00 00 00 00 02 9F 03
            29 01 00 00 00 00 02 A0 37
            29 01 00 00 00 00 01 A1
            29 01 00 00 00 00 02 A2 03
            29 01 00 00 00 00 02 A3 56
            29 01 00 00 00 00 02 A4 03
            29 01 00 00 00 00 02 A5 79
            29 01 00 00 00 00 02 A6 03
            29 01 00 00 00 00 02 A7 99
            29 01 00 00 00 00 01 A8
            29 01 00 00 00 00 02 A9 03
            29 01 00 00 00 00 02 AA A7
            29 01 00 00 00 00 02 AB 03
            29 01 00 00 00 00 02 AC B9
            29 01 00 00 00 00 02 AD 03
            29 01 00 00 00 00 02 AE BD
            //Gamma B- 
            29 01 00 00 00 00 02 AF 00
            29 01 00 00 00 00 02 B0 D9
            29 01 00 00 00 00 02 B1 01
            29 01 00 00 00 00 02 B2 0C
            29 01 00 00 00 00 02 B3 01
            29 01 00 00 00 00 02 B4 13
            29 01 00 00 00 00 02 B5 01
            29 01 00 00 00 00 02 B6 26
            29 01 00 00 00 00 02 B7 01
            29 01 00 00 00 00 02 B8 33
            29 01 00 00 00 00 02 B9 01
            29 01 00 00 00 00 02 BA 45
            29 01 00 00 00 00 02 BB 01
            29 01 00 00 00 00 02 BC 50
            29 01 00 00 00 00 02 BD 01
            29 01 00 00 00 00 02 BE 5D
            29 01 00 00 00 00 02 BF 01
            29 01 00 00 00 00 02 C0 69
            29 01 00 00 00 00 02 C1 01
            29 01 00 00 00 00 02 C2 8E
            29 01 00 00 00 00 02 C3 01
            29 01 00 00 00 00 02 C4 A8
            29 01 00 00 00 00 02 C5 01
            29 01 00 00 00 00 02 C6 DC
            29 01 00 00 00 00 02 C7 02
            29 01 00 00 00 00 02 C8 04
            29 01 00 00 00 00 02 C9 02
            29 01 00 00 00 00 02 CA 43
            29 01 00 00 00 00 02 CB 02
            29 01 00 00 00 00 02 CC 87
            29 01 00 00 00 00 02 CD 02
            29 01 00 00 00 00 02 CE 87
            29 01 00 00 00 00 02 CF 02
            29 01 00 00 00 00 02 D0 AA
            29 01 00 00 00 00 02 D1 02
            29 01 00 00 00 00 02 D2 E4
            29 01 00 00 00 00 02 D3 03
            29 01 00 00 00 00 02 D4 05
            29 01 00 00 00 00 02 D5 03
            29 01 00 00 00 00 02 D6 2E
            29 01 00 00 00 00 02 D7 03
            29 01 00 00 00 00 02 D8 51
            29 01 00 00 00 00 02 D9 03
            29 01 00 00 00 00 02 DA 76
            29 01 00 00 00 00 02 DB 03
            29 01 00 00 00 00 02 DC 83
            29 01 00 00 00 00 02 DD 03
            29 01 00 00 00 00 02 DE 8F
            29 01 00 00 00 00 02 DF 03
            29 01 00 00 00 00 02 E0 B2
            29 01 00 00 00 00 02 E1 03
            29 01 00 00 00 00 02 E2 DA
            29 01 00 00 00 00 02 E3 03
            29 01 00 00 00 00 02 E4 E4
            29 01 00 00 00 00 02 E5 03
            29 01 00 00 00 00 02 E6 E6
            29 01 00 00 00 00 02 E7 03
            29 01 00 00 00 00 02 E8 E8
            29 01 00 00 00 00 02 E9 03
            29 01 00 00 00 00 02 EA EA
            //Page select (CMD1) 
            29 01 00 00 00 00 02 FF 00
            29 01 00 00 00 00 02 FB 01
            //gamma end
			29 01 00 00 00 00 02 ff 04
			29 01 00 00 00 00 02 fb 01
			29 01 00 00 00 00 02 ff 00
			29 01 00 00 00 00 02 fb 01
            //CMD2 Page 4 -Display Register
            29 01 00 00 00 00 02 FF 05
            29 01 00 00 00 00 02 FB 01
            29 01 00 00 00 00 02 01 00
            29 01 00 00 00 00 02 02 7F
            29 01 00 00 00 00 02 03 7F
            29 01 00 00 00 00 02 04 7F
            29 01 00 00 00 00 02 05 00
            29 01 00 00 00 00 02 06 00
            29 01 00 00 00 00 02 07 00
            29 01 00 00 00 00 02 08 00
            29 01 00 00 00 00 02 09 02
            29 01 00 00 00 00 02 0A 01
            29 01 00 00 00 00 02 0B 75
            29 01 00 00 00 00 02 0D 0E
            29 01 00 00 00 00 02 0E 1A
            29 01 00 00 00 00 02 0F 09
            29 01 00 00 00 00 02 10 80
            29 01 00 00 00 00 02 14 04
            29 01 00 00 00 00 02 16 08
            29 01 00 00 00 00 02 17 00
            29 01 00 00 00 00 02 19 1F
            29 01 00 00 00 00 02 1A 00
            29 01 00 00 00 00 02 1B FC
            29 01 00 00 00 00 02 1C 00
            29 01 00 00 00 00 02 1D 00
            29 01 00 00 00 00 02 1E 00
            29 01 00 00 00 00 02 1F 80
            29 01 00 00 00 00 02 21 00
            29 01 00 00 00 00 02 24 45
            29 01 00 00 00 00 02 27 05
            29 01 00 00 00 00 02 28 00
            29 01 00 00 00 00 02 29 52
            29 01 00 00 00 00 02 2A A9
            29 01 00 00 00 00 02 2D 02
            29 01 00 00 00 00 02 2F 00
            29 01 00 00 00 00 02 30 30
            29 01 00 00 00 00 02 35 16
            29 01 00 00 00 00 02 36 01
            29 01 00 00 00 00 02 37 00
            29 01 00 00 00 00 02 38 02
            29 01 00 00 00 00 02 39 01
            29 01 00 00 00 00 02 3F 00
            29 01 00 00 00 00 02 40 00
            29 01 00 00 00 00 02 41 00
            29 01 00 00 00 00 02 42 00
            29 01 00 00 00 00 02 4A 01
            29 01 00 00 00 00 02 6F 25
            29 01 00 00 00 00 02 7E E9
            29 01 00 00 00 00 02 82 18
            29 01 00 00 00 00 02 89 C1
            29 01 00 00 00 00 02 A4 05
            29 01 00 00 00 00 02 BB 06
            29 01 00 00 00 00 02 BC 02
            29 01 00 00 00 00 02 FF 00
            29 01 00 00 00 00 02 FB 01
            //CMD1
            29 01 00 00 00 00 02 FF 00 
            29 01 00 00 00 00 02 fb 01			
            29 01 00 00 00 00 02 BA 03
            15 01 00 00 00 00 02 55 00
            39 01 00 00 00 00 02 53 24
            39 01 00 00 00 00 02 35 20
            39 01 00 00 96 00 02 11 00
            39 01 00 00 00 00 02 29 00
		];
		qcom,mdss-dsi-off-command = [39 01 00 00 32 00 02 28 00
					39 01 00 00 78 00 02 10 00];
		qcom,mdss-dsi-on-command-state = "dsi_lp_mode";
		qcom,mdss-dsi-off-command-state = "dsi_hs_mode";
		qcom,mdss-dsi-h-sync-pulse = <1>;
		qcom,mdss-dsi-traffic-mode = "burst_mode";
		qcom,mdss-dsi-lane-map = <0>;
		qcom,mdss-dsi-bllp-eof-power-mode;
		qcom,mdss-dsi-bllp-power-mode;
		qcom,mdss-dsi-lane-0-state;
		qcom,mdss-dsi-lane-1-state;
		qcom,mdss-dsi-lane-2-state;
		qcom,mdss-dsi-lane-3-state;
		qcom,mdss-dsi-panel-timings = [32 16 0e 00 38 3a 12 18 10 03 04 00];
		qcom,mdss-dsi-t-clk-post = <0x4>;
		qcom,mdss-dsi-t-clk-pre = <0x17>;
		qcom,mdss-dsi-bl-min-level = <1>;
		qcom,mdss-dsi-bl-max-level = <255>;
		qcom,mdss-dsi-dma-trigger = <4>;
		qcom,mdss-dsi-mdp-trigger = <0>;
		qcom,mdss-dsi-bl-pmic-control-type = "bl_ctrl_dcs";
		qcom,mdss-dsi-reset-sequence = <1 1500>, <0 30>, <1 23000>;
		qcom,mdss-pan-physical-width-dimension = <59>;
		qcom,mdss-pan-physical-height-dimension = <104>;

	};
};
