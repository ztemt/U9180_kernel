/* Copyright (c) 2013, The Linux Foundation. All rights reserved.
 *
 * This program is free software; you can redistribute it and/or modify
 * it under the terms of the GNU General Public License version 2 and
 * only version 2 as published by the Free Software Foundation.
 *
 * This program is distributed in the hope that it will be useful,
 * but WITHOUT ANY WARRANTY; without even the implied warranty of
 * MERCHANTABILITY or FITNESS FOR A PARTICULAR PURPOSE.  See the
 * GNU General Public License for more details.
 */

/*---------------------------------------------------------------------------
 * This file is autogenerated file using gcdb parser. Please do not edit it.
 * Update input XML file to add a new entry or update variable in this file
 * VERSION = "1.0"
 *---------------------------------------------------------------------------*/
&mdss_mdp {
	dsi_otm1282a_720_vid: qcom,mdss_dsi_tianma_otm1282a_720p_video {
		qcom,mdss-dsi-panel-name = "tianma 720p video mode dsi panel";
		qcom,mdss-dsi-panel-controller = <&mdss_dsi0>;
		qcom,mdss-dsi-panel-type = "dsi_video_mode";
		qcom,mdss-dsi-panel-destination = "display_1";
		qcom,mdss-dsi-panel-framerate = <60>;
		qcom,mdss-dsi-virtual-channel-id = <0>;
		qcom,mdss-dsi-stream = <0>;
		qcom,mdss-dsi-panel-width = <720>;
		qcom,mdss-dsi-panel-height = <1280>;
		qcom,mdss-dsi-h-front-porch = <120>;
		qcom,mdss-dsi-h-back-porch = <80>;
		qcom,mdss-dsi-h-pulse-width = <20>;
		qcom,mdss-dsi-h-sync-skew = <0>;
		qcom,mdss-dsi-v-back-porch = <13>;
		qcom,mdss-dsi-v-front-porch = <8>;
		qcom,mdss-dsi-v-pulse-width = <4>;
		qcom,mdss-dsi-h-left-border = <0>;
		qcom,mdss-dsi-h-right-border = <0>;
		qcom,mdss-dsi-v-top-border = <0>;
		qcom,mdss-dsi-v-bottom-border = <0>;
		qcom,mdss-dsi-bpp = <24>;
		qcom,mdss-dsi-color-order = <0>;
		qcom,mdss-dsi-underflow-color = <0xff>;
		qcom,mdss-dsi-border-color = <0>;
		qcom,mdss-dsi-on-command = [29 01 00 00 01 00 04 FF 12 82 01
					23 01 00 00 01 00 02 00 80
					29 01 00 00 05 00 03 FF 12 82
					23 01 00 00 05 00 02 00 00
					23 01 00 00 00 00 02 1C 30
					23 01 00 00 00 00 02 00 A1
					23 01 00 00 00 00 02 C1 EE
					23 01 00 00 00 00 02 00 80
					29 01 00 00 01 00 05 C4 04 0C 00 22
					23 01 00 00 00 00 02 00 80
					29 01 00 00 00 00 04 C5 20 09 00
					23 01 00 00 00 00 02 00 90
					29 01 00 00 00 00 0b C5 12 D6 D0 D0 8F 95 44 33 30 88
					23 01 00 00 00 00 02 00 A0
					29 01 00 00 00 00 0b C5 12 D6 D0 D0 8F 95 44 33 30 88
					23 01 00 00 00 00 02 00 C1
					29 01 00 00 00 00 02 C5 BA
					23 01 00 00 00 00 02 00 00
					29 01 00 00 00 00 03 D8 2E 2E
					23 01 00 00 00 00 02 00 00
					23 01 00 00 00 00 02 D9 90
					23 01 00 00 00 00 02 00 80
					29 01 00 00 00 00 04 A5 0C 02 01
					23 01 00 00 00 00 02 00 80
					29 01 00 00 00 00 0f C0 00 85 00 06 06 00 85 06 06 00 85 00 06 06
					23 01 00 00 00 00 02 00 A0
					29 01 00 00 00 00 0d C0 00 00 00 1D 06 15 03 00 00 00 00 00
					23 01 00 00 00 00 02 00 80
					29 01 00 00 00 00 09 C2 84 02 79 14 84 00 4D A2
					23 01 00 00 00 00 02 00 90
					29 01 00 00 00 00 10 C2 83 04 01 0B 00 82 04 01 0B 00 81 04 01 0B 00
					23 01 00 00 00 00 02 00 A0
					29 01 00 00 00 00 10 C2 84 04 01 0B 00 83 04 01 0B 00 82 04 81 0B 00
					23 01 00 00 00 00 02 00 B0
					29 01 00 00 00 00 0b C2 81 04 01 0B 00 84 04 01 0B 00
					23 01 00 00 00 00 02 00 F8
					23 01 00 00 00 00 02 C2 02
					23 01 00 00 00 00 02 00 FA
					29 01 00 00 00 00 04 C2 00 0C 01
					23 01 00 00 00 00 02 00 C9
					23 01 00 00 00 00 02 CB 01
					23 01 00 00 00 00 02 00 90
					29 01 00 00 00 00 10 CB 00 00 00 00 00 00 00 00 00 00 00 00 00 00 00
					23 01 00 00 00 00 02 00 A0
					29 01 00 00 00 00 10 CB 00 00 00 00 00 00 00 00 00 00 00 00 00 00 00
					23 01 00 00 00 00 02 00 B0
					29 01 00 00 00 00 10 CB 00 00 00 00 00 00 00 00 00 00 00 00 00 00 00
					23 01 00 00 00 00 02 00 80
					29 01 00 00 00 00 03 F5 21 18
					23 01 00 00 00 00 02 00 D2
					23 01 00 00 00 00 02 F5 28
					23 01 00 00 00 00 02 00 91
					23 01 00 00 00 00 02 B0 9E
					23 01 00 00 00 00 02 00 90
					23 01 00 00 00 00 02 A5 00
					23 01 00 00 00 00 02 00 B3
					23 01 00 00 00 00 02 C0 33
					23 01 00 00 00 00 02 00 B4
					23 01 00 00 00 00 02 C0 40
					23 01 00 00 00 00 02 00 C0
					29 01 00 00 00 00 10 CB 04 04 04 04 04 04 04 04 04 04 04 04 04 28 28
					23 01 00 00 00 00 02 00 D0
					29 01 00 00 00 00 10 CB 28 28 14 04 18 3C 04 F7 04 14 14 14 14 04 04
					23 01 00 00 00 00 02 00 E0
					29 01 00 00 00 00 10 CB 04 04 04 04 04 04 04 04 15 15 07 14 14 00 00
					23 01 00 00 00 00 02 00 F0
					29 01 00 00 00 00 0d CB FF FF F3 03 30 30 00 00 00 00 00 00
					23 01 00 00 00 00 02 00 80
					29 01 00 00 00 00 0b CC 01 03 04 05 06 07 08 09 0A 02
					23 01 00 00 00 00 02 00 B0
					29 01 00 00 00 00 0b CC 01 0A 09 08 07 06 05 04 03 02
					23 01 00 00 00 00 02 00 A0
					29 01 00 00 00 00 10 CD 02 2D 04 2D 2D 2D 2D 2D 2D 2D 2D 2D 2D 2D 2D
					23 01 00 00 00 00 02 00 B0
					29 01 00 00 00 00 10 CD 2D 2D 2D 14 01 0A 2D 2D 2D 2D 2D 2D 2D 2D 2D
					23 01 00 00 00 00 02 00 C0
					29 01 00 00 00 00 0b CD 2D 2D 2D 27 28 29 2A 2B 1D 2D
					23 01 00 00 00 00 02 00 D0
					29 01 00 00 00 00 10 CD 2D 03 2D 05 2D 2D 2D 2D 2D 2D 2D 2D 2D 2D 2D
					23 01 00 00 00 00 02 00 E0
					29 01 00 00 00 00 10 CD 2D 2D 2D 14 01 0A 0C 0B 13 2D 2D 2D 2D 2D 2D
					23 01 00 00 00 00 02 00 F0
					29 01 00 00 00 00 0b CD 2D 2D 2D 27 28 29 2A 2B 1D 2D
					23 01 00 00 00 00 02 00 D0
					29 01 00 00 00 00 0d C0 00 00 00 1D 06 15 03 00 00 00 00 00
					23 01 00 00 00 00 02 00 80
					29 01 00 00 00 00 09 C3 84 02 79 14 84 00 4D A2
					23 01 00 00 00 00 02 00 90
					29 01 00 00 00 00 10 C3 83 04 01 0B 00 82 04 01 0B 00 81 04 01 0B 00
					23 01 00 00 00 00 02 00 A0
					29 01 00 00 00 00 10 C3 84 04 01 0B 00 83 04 01 0B 00 82 04 81 0B 00
					23 01 00 00 00 00 02 00 B0
					29 01 00 00 00 00 0b C3 81 04 01 0B 00 84 04 01 0B 00
					23 01 00 00 00 00 02 00 EA
					29 01 00 00 00 00 04 C3 00 01 11
					23 01 00 00 00 00 02 00 00
					29 01 00 00 00 00 19 E1 2a 2d 3b 47 4f 56 61 70 7a 88 92 99 61 5c 56 4b 39 2a 22 1c 17 12 10 0e
					23 01 00 00 00 00 02 00 00
					29 01 00 00 00 00 19 E2 2a 2d 3b 46 4f 56 60 70 7a 89 93 9a 60 5d 57 4a 39 2a 23 1c 17 12 10 0e
					23 01 00 00 00 00 02 00 00
					29 01 00 00 00 00 19 E3 2a 2d 3b 47 4f 56 61 70 7a 88 92 99 61 5c 56 4b 39 2a 22 1c 17 12 10 0e
					23 01 00 00 00 00 02 00 00
					29 01 00 00 00 00 19 E4 2a 2d 3b 46 4f 56 60 70 7a 89 93 9a 60 5d 57 4a 39 2a 23 1c 17 12 10 0e
					23 01 00 00 00 00 02 00 00
					29 01 00 00 00 00 19 E5 2a 2d 3b 47 4f 56 61 70 7a 88 92 99 61 5c 56 4b 39 2a 22 1c 17 12 10 0e
					23 01 00 00 00 00 02 00 00
					29 01 00 00 00 00 19 E6 2a 2d 3b 46 4f 56 60 70 7a 89 93 9a 60 5d 57 4a 39 2a 23 1c 17 12 10 0e
					39 01 00 00 00 00 02 51 00
					39 01 00 00 00 00 02 53 24
					23 01 00 00 00 00 02 00 81
					23 01 00 00 00 00 02 C1 66
					23 01 00 00 00 00 02 00 80
					29 01 00 00 00 00 04 FF 00 00 00
					23 01 00 00 00 00 02 00 00
					29 01 00 00 00 00 04 FF 00 00 00
					39 01 00 00 78 00 02 11 00
					05 01 00 00 00 00 02 13 00
					39 01 00 00 0a 00 02 29 00];
		qcom,mdss-dsi-off-command = [39 01 00 00 00 00 02 51 00
					39 01 00 00 00 00 02 53 00
					39 01 00 00 32 00 02 22 00
					39 01 00 00 02 00 02 28 00
					39 01 00 00 7c 00 02 10 00];
		qcom,mdss-dsi-on-command-state = "dsi_lp_mode";
		qcom,mdss-dsi-off-command-state = "dsi_hs_mode";
		qcom,mdss-dsi-h-sync-pulse = <1>;
		qcom,mdss-dsi-traffic-mode = <2>;
		qcom,mdss-dsi-lane-map = <0>;
		qcom,mdss-dsi-bllp-eof-power-mode;
		qcom,mdss-dsi-bllp-power-mode;
		qcom,mdss-dsi-lane-0-state;
		qcom,mdss-dsi-lane-1-state;
		qcom,mdss-dsi-lane-2-state;
		qcom,mdss-dsi-lane-3-state;
		qcom,mdss-dsi-panel-timings = [8b 47 14 00 56 56 19 4b 1f 03 04 a0];
		qcom,mdss-dsi-t-clk-post = <0x08>;
		qcom,mdss-dsi-t-clk-pre = <0x21>;
		qcom,mdss-dsi-bl-min-level = <1>;
		qcom,mdss-dsi-bl-max-level = <4095>;
		qcom,mdss-dsi-dma-trigger = <4>;
		qcom,mdss-dsi-mdp-trigger = <0>;
		qcom,mdss-dsi-bl-pmic-control-type = "bl_ctrl_wled";
		qcom,mdss-dsi-reset-sequence = <1 20>, <0 1>, <1 20>;
		qcom,mdss-pan-physical-width-dimension = <59>;
		qcom,mdss-pan-physical-height-dimension = <104>;

	};
};
