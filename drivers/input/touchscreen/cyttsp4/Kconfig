## drivers/input/touchscreen/cyttsp4/Kconfig
```kconfig
menuconfig CYPRSS_TOUCHSCREEN_TMA463
	bool "CYPRSS_TOUCHSCREEN_TMA463"
	help
	  Say Y here, and a list of supported touchscreens will be displayed.
	  This option doesn't affect the kernel.

	  If unsure, say Y.

if CYPRSS_TOUCHSCREEN_TMA463

choice
	prompt "Cypress TTSP Screen Size of the Module"

config CYTTSP4_5P0_INCH_OTG_GW
	bool "5.0 inch OTG TP"
	help
	  This option enables support Cypress TTSP 5.0 inch TP.
	
config CYTTSP4_4P7_INCH_OTG_GW
	bool "4.7 inch OTG TP"
	help
	  This option enables support Cypress TTSP 4.7 inch TP.	
endchoice

config CYPRESS_CYTTSP4_BUS
	bool "Cypress TTSP core bus"
	default n
	help
	  This option enables support Cypress TTSP core bus.
	  This support is needed for various device and drivers
	  using Cypress TrueTouch(TM) Standard Product
	  protocol.

config TOUCHSCREEN_CYPRESS_CYTTSP4
	tristate "Cypress TrueTouch Gen4 Touchscreen Driver"
	default n
	depends on CYPRESS_CYTTSP4_BUS

	help
	  Say Y here if you have a Cypress Gen4 touchscreen.

	  If unsure, say N.

	  To compile this driver as a module, choose M here.

config TOUCHSCREEN_CYPRESS_CYTTSP4_DEBUG
	bool "Enable debug output"
	depends on TOUCHSCREEN_CYPRESS_CYTTSP4
	default n

config TOUCHSCREEN_CYPRESS_CYTTSP4_VDEBUG
	bool "Enable verbose debug output"
	depends on TOUCHSCREEN_CYPRESS_CYTTSP4_DEBUG
	default n

config TOUCHSCREEN_CYPRESS_CYTTSP4_I2C
	tristate "Cypress TrueTouch Gen4 I2C"
	depends on TOUCHSCREEN_CYPRESS_CYTTSP4
	default n

config TOUCHSCREEN_CYPRESS_CYTTSP4_SPI
	tristate "Cypress TrueTouch Gen4 SPI"
	depends on TOUCHSCREEN_CYPRESS_CYTTSP4
	default n

config TOUCHSCREEN_CYPRESS_CYTTSP4_MT_A
	tristate "Cypress TrueTouch Gen4 MultiTouch Protocol A"
	depends on TOUCHSCREEN_CYPRESS_CYTTSP4
	default n

config TOUCHSCREEN_CYPRESS_CYTTSP4_MT_B
	tristate "Cypress TrueTouch Gen4 MultiTouch Protocol B"
	depends on TOUCHSCREEN_CYPRESS_CYTTSP4
	default n

config TOUCHSCREEN_CYPRESS_CYTTSP4_BUTTON
	tristate "Cypress TrueTouch Gen4 MultiTouch CapSense Button"
	depends on TOUCHSCREEN_CYPRESS_CYTTSP4
	default n

config TOUCHSCREEN_CYPRESS_CYTTSP4_DEVICE_ACCESS
	tristate "Cypress TrueTouch Gen4 MultiTouch Device Access"
	depends on TOUCHSCREEN_CYPRESS_CYTTSP4
	default n

config TOUCHSCREEN_CYPRESS_CYTTSP4_LOADER
	tristate "Cypress TrueTouch Gen4 MultiTouch Loader"
	depends on TOUCHSCREEN_CYPRESS_CYTTSP4
	default n

config TOUCHSCREEN_CYPRESS_CYTTSP4_DEBUG_MODULE
	tristate "Cypress TrueTouch Gen4 MultiTouch Debug Module"
	depends on TOUCHSCREEN_CYPRESS_CYTTSP4
	default n

config TOUCHSCREEN_CYPRESS_CYTTSP4_AUTO_LOAD_TOUCH_PARAMS
	tristate "Cypress TrueTouch Gen4 MultiTouch auto load touch params"
	depends on TOUCHSCREEN_CYPRESS_CYTTSP4
	default n	

endif
```

## drivers/input/touchscreen/gt915/Kconfig
```kconfig
#
# Goodix GT9xx Touchscreen driver
#

menuconfig ZTEMT_TOUCHSCREEN_GT9XX
	bool "ZTEMT_TOUCHSCREEN_GT9XX"
	help
	  Say Y here, and a list of supported touchscreens will be displayed.
	  This option doesn't affect the kernel.

	  If unsure, say Y.

if ZTEMT_TOUCHSCREEN_GT9XX

config ZTEMT_GT9XX_TOUCHSCREEN_DRIVER
	tristate "Goodix GT9xx touchpanel driver"
	depends on ZTEMT_TOUCHSCREEN_GT9XX
	default n
	help
	  This is the main file for touchpanel driver for Goodix GT9xx
	  touchscreens.

	  Say Y here if you have a Goodix GT9xx touchscreen connected
	  to your system.

	  If unsure, say N.

	  To compile this driver as a module, choose M here: the
	  module will be called gt9xx_update.

config ZTEMT_GT9XX_TOUCHSCREEN_UPDATE
	tristate "Goodix GT9xx touchpanel auto update support"
	depends on ZTEMT_GT9XX_TOUCHSCREEN_DRIVER
	default n
	help
	  This enables support for firmware update for Goodix GT9xx
	  touchscreens.

	  Say Y here if you have a Goodix GT9xx touchscreen connected
	  to your system.

	  If unsure, say N.

	  To compile this driver as a module, choose M here: the
	  module will be called gt9xx_update.

config ZTEMT_GT9XX_TOUCHSCREEN_DEBUG
	tristate "Goodix GT9xx Tools for debuging"
	depends on ZTEMT_GT9XX_TOUCHSCREEN_DRIVER
	default n
	help
	  This is application debug interface support for Goodix GT9xx
	  touchscreens.

	  Say Y here if you want to have a Android app debug interface
	  to your system.

	  If unsure, say N.

	  To compile this driver as a module, choose M here: the
	  module will be called gt9xx_update.

config ZTEMT_GT9XX_TOUCHSCREEN_TEST
       tristate "Goodix GT9xx Tools for testing"
       depends on ZTEMT_GT9XX_TOUCHSCREEN_DRIVER
       default n
       help
         This is application test interface support for Goodix GT9xx
         touchscreens.

         Say Y here if you want to have a Android app debug interface
         to your system.

         If unsure, say N.

         To compile this driver as a module, choose M here: the
         module will be called gt9xx_update.


endif
```

## drivers/input/touchscreen/synaptics_dsx/Kconfig
```kconfig
menuconfig ZTEMT_TOUCHSCREEN_SYNAPTICS_DSX
	bool "ZTEMT_TOUCHSCREEN_SYNAPTICS_DSX"
	help
	  Say Y here, and a list of supported touchscreens will be displayed.
	  This option doesn't affect the kernel.

	  If unsure, say Y.

if ZTEMT_TOUCHSCREEN_SYNAPTICS_DSX

choice
	prompt "Synaptics Touch Screen Size of the Module"
	
config ZTEMT_TOUCHSCREEN_SYNAPTICS_5P0_INCH_TP
	bool "5.0 inch OTG TP"
	help
	  This option enables support 5.0 inch otg tp.	

config ZTEMT_TOUCHSCREEN_SYNAPTICS_4P7_INCH_TP_2
	bool "4.7 inch OTG TP for mini2"
	help
	  This option enables support 4.7 inch otg tp.
endchoice

config ZTEMT_TOUCHSCREEN_SYNAPTICS_DSX_I2C
	tristate "Synaptics DSX I2C touchscreen"
	depends on I2C
	help
	  Say Y here if you have a Synaptics DSX I2C touchscreen
	  connected to your system.

	  If unsure, say N.

	  To compile this driver as a module, choose M here: the
	  module will be called synaptics_dsx_i2c.

config ZTEMT_TOUCHSCREEN_SYNAPTICS_DSX_RMI_DEV
	tristate "Synaptics DSX touchscreen char device"
	depends on ZTEMT_TOUCHSCREEN_SYNAPTICS_DSX_I2C
	help
	  This enables support for direct register access for Synaptics DSX
	  touchscreens.

config ZTEMT_TOUCHSCREEN_SYNAPTICS_DSX_TEST_REPORTING
	tristate "Synaptics DSX touchscreen test reporting"
	depends on ZTEMT_TOUCHSCREEN_SYNAPTICS_DSX_I2C
	help
	  This enables support for test reporting for Synaptics DSX
	  touchscreens.

config ZTEMT_TOUCHSCREEN_SYNAPTICS_DSX_FW_UPDATE
	tristate "Synaptics DSX touchscreen firmware update"
	depends on ZTEMT_TOUCHSCREEN_SYNAPTICS_DSX_I2C
	help
	  This enables support for firmware update for Synaptics DSX
	  touchscreens.

config ZTEMT_TOUCHSCREEN_SYNAPTICS_DSX_DEBUG
	bool "Enable debug output"
	depends on ZTEMT_TOUCHSCREEN_SYNAPTICS_DSX_I2C
	default n

endif
```

## drivers/video/msm/mdss/Kconfig
```kconfig
config FB_MSM_MDSS_WRITEBACK
	bool "MDSS Writeback Panel"
	---help---
	The MDSS Writeback Panel provides support for routing the output of
	MDSS frame buffer driver and MDP processing to memory.

config FB_MSM_MDSS_HDMI_PANEL
	depends on FB_MSM_MDSS
	bool "MDSS HDMI Tx Panel"
	default n
	---help---
	The MDSS HDMI Panel provides support for transmitting TMDS signals of
	MDSS frame buffer data to connected hdmi compliant TVs, monitors etc.

config FB_MSM_MDSS_HDMI_MHL_SII8334
	depends on FB_MSM_MDSS_HDMI_PANEL
	bool 'MHL SII8334 support '
	default n
	---help---
	  Support the HDMI to MHL conversion.
	  MHL (Mobile High-Definition Link) technology
	  uses USB connector to output HDMI content

config FB_MSM_MDSS_DSI_CTRL_STATUS
	tristate "DSI controller status check feature"
	---help---
	  Check DSI controller status periodically (default period is 5
	  seconds) by sending Bus-Turn-Around (BTA) command. If DSI controller
	  fails to acknowledge the BTA command, it sends PANEL_ALIVE=0 status
	  to HAL layer to reset the controller.
#mayu 2012.12.19
menu "ZTEMT lcd driver support"
config ZTEMT_LCD_MIPI_COMMON
	bool "ztemt lcd MIPI interface driver module"
	default n

config ZTEMT_NE501_LCD
	bool "ztemt NE501J LCD driver module"
	default n

config ZTEMT_LCD_POWER_CONTRL
	bool "ztemt lcd AVDD IOVDD contrl"
	depends on ZTEMT_LCD_MIPI_COMMON
	default n
config ZTEMT_LCD_DISP_ENHANCE
	bool "LCD disp color enhance"
	depends on ZTEMT_LCD_MIPI_COMMON
	default n
config ZTEMT_MIPI_720P_R69431_SHARP_IPS_4P7
	bool "MIPI 720P R69431 SHARP IPS 4P7"
	depends on ZTEMT_LCD_MIPI_COMMON
	default n
config ZTEMT_MIPI_720P_NT35592_SHARP_IPS_5P
	bool "MIPI 720P NT35592 SHARP IPS 5P"
	depends on ZTEMT_LCD_MIPI_COMMON
	default n
config ZTEMT_LCD_ESD_TE_CHECK
	bool "LCD esd te check"
	depends on ZTEMT_LCD_MIPI_COMMON
	default n
endmenu
```
